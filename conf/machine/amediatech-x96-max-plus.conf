## conf/machine/amediatech-x96-max-plus.conf
```bitbake
#@TYPE: Machine
#@NAME: Amediatech X96 Max Plus machine
#@DESCRIPTION: Machine configuration for legacy boot

require conf/machine/include/amlogic-s905x3.inc
require conf/machine/include/amediatech-x96-max-plus-dtb.inc
require conf/machine/include/amlogic-legacy-boot.inc

MACHINE_FEATURES:append = " alsa ext2 screen usbgadget usbhost sdio vfat wifi bluetooth"
```

## conf/machine/include/amediatech-x96-max-plus-dtb.inc
```bitbake
# Amediatech X96 Max

KERNEL_DEVICETREE += "amlogic/meson-sm1-x96-max-plus.dtb"
IMAGE_BOOT_FILES += "meson-sm1-x96-max-plus.dtb"
```
